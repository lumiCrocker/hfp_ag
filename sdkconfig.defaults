## sdkconfig.defaults
```kconfig
# Override some defaults so BT stack is enabled and
# Classic BT is enabled and BT_DRAM_RELEASE is disabled
CONFIG_BT_ENABLED=y
CONFIG_BT_BLE_ENABLED=n
CONFIG_BTDM_CTRL_MODE_BR_EDR_ONLY=y
CONFIG_BT_BLUEDROID_ENABLED=y
CONFIG_BT_CLASSIC_ENABLED=y
CONFIG_BT_HFP_ENABLE=y
CONFIG_BT_HFP_AG_ENABLE=y

# Tala Settings
BTDM_CTRL_BR_EDR_SCO_DATA_PATH=y
BT_SSP_ENABLED=y
BT_HID_HOST_ENABLED=y
BTDM_CTRL_BR_EDR_MAX_SYNC_CONN=1
BTDM_CTRL_BR_EDR_SCO_DATA_PATH=y
```
